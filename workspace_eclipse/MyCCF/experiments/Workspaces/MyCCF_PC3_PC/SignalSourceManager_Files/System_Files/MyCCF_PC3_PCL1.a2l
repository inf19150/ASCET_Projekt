ASAP2_VERSION 1 41
/begin PROJECT MyCCF_PC3_PC "Generated by ETAS from Project MyCCF_PC3_PC"
/begin HEADER "" VERSION "000" PROJECT_NO ASD /end HEADER
/begin MODULE MyCCF_PC3_PC "Generated by ETAS ASCET7 from Project: MyCCF_PC3_PC"
/begin IF_DATA E_TARGET
 /begin SOURCE "Task0" 3 /* period */ 10 QP_BLOB 1 /end SOURCE
 /begin TP_BLOB /* programm id */ 494940797 /* target id */ 7 0 2 0 /end TP_BLOB
/end IF_DATA
/begin MOD_PAR "" VERSION "000" ADDR_EPK 0x0 EPK "" SUPPLIER "ETAS GmbH" CUSTOMER "xxx" CUSTOMER_NO "000" USER "xxx" PHONE_NO "000" ECU "PC" CPU_TYPE "PCx86" NO_OF_INTERFACES 1 /end MOD_PAR
/begin MOD_COMMON "Common definitions" BYTE_ORDER MSB_LAST ALIGNMENT_BYTE 1 ALIGNMENT_WORD 2 ALIGNMENT_LONG 4 ALIGNMENT_FLOAT32_IEEE 4 ALIGNMENT_FLOAT64_IEEE 8 /end MOD_COMMON
/begin MEASUREMENT myCar.myCar.myVehicle.MyTurn_instance.x "" FLOAT32_IEEE esdl_ident 1 100.0 -3.4028234663852886E+38 3.4028234663852886E+38 ECU_ADDRESS 0x0 /end MEASUREMENT
/begin MEASUREMENT myCar.myCar.myVehicle.MyTurn_instance.y "" FLOAT32_IEEE esdl_ident 1 100.0 -3.4028234663852886E+38 3.4028234663852886E+38 ECU_ADDRESS 0x0 /end MEASUREMENT
/begin MEASUREMENT myCar.myCar.myVehicle.MyTurn_instance.bearing "" FLOAT32_IEEE esdl_ident 1 100.0 -3.4028234663852886E+38 3.4028234663852886E+38 ECU_ADDRESS 0x0 /end MEASUREMENT
/begin CHARACTERISTIC myCar.myCar.myVehicle.MyTurn_instance.D "" VALUE 0x0 STANDARD_VALUE_R32 0.0 esdl_ident -3.4028234663852886E+38 3.4028234663852886E+38 /end CHARACTERISTIC
/begin MEASUREMENT myCar.myCar.myVehicle.MyTurn_instance.dpi "" FLOAT32_IEEE esdl_ident 1 100.0 -3.4028234663852886E+38 3.4028234663852886E+38 ECU_ADDRESS 0x0 /end MEASUREMENT
/begin MEASUREMENT myCar.myCar.myVehicle.MyTurn_instance.pi "" FLOAT32_IEEE esdl_ident 1 100.0 -3.4028234663852886E+38 3.4028234663852886E+38 ECU_ADDRESS 0x0 /end MEASUREMENT
/begin CHARACTERISTIC myCar.myCar.myVehicle.BrakeMomentum "" CURVE 0x0 STANDARD_CURVE_R32R32 0.0 esdl_ident -3.4028234663852886E+38 3.4028234663852886E+38
 /begin AXIS_DESCR STD_AXIS NO_INPUT_QUANTITY esdl_ident 6 -3.4028234663852886E+38 3.4028234663852886E+38 /end AXIS_DESCR
/end CHARACTERISTIC
/begin CHARACTERISTIC myCar.myCar.myVehicle.EngineMomentum "" MAP 0x0 STANDARD_MAP_R32R32R32 0.0 esdl_ident -3.4028234663852886E+38 3.4028234663852886E+38
 /begin AXIS_DESCR STD_AXIS NO_INPUT_QUANTITY esdl_ident 6 -3.4028234663852886E+38 3.4028234663852886E+38 /end AXIS_DESCR
 /begin AXIS_DESCR STD_AXIS myCar.myCar.myVehicle.v esdl_ident 6 -3.4028234663852886E+38 3.4028234663852886E+38 /end AXIS_DESCR
/end CHARACTERISTIC
/begin CHARACTERISTIC myCar.myCar.myVehicle.AirFriction "" CURVE 0x0 STANDARD_CURVE_R32R32 0.0 esdl_ident -3.4028234663852886E+38 3.4028234663852886E+38
 /begin AXIS_DESCR STD_AXIS myCar.myCar.myVehicle.v esdl_ident 6 -3.4028234663852886E+38 3.4028234663852886E+38 /end AXIS_DESCR
/end CHARACTERISTIC
/begin CHARACTERISTIC myCar.myCar.myVehicle.Landscape "" CURVE 0x0 STANDARD_CURVE_R32R32 0.0 esdl_ident -3.4028234663852886E+38 3.4028234663852886E+38
 /begin AXIS_DESCR STD_AXIS myCar.myCar.myVehicle.dist esdl_ident 128 -3.4028234663852886E+38 3.4028234663852886E+38 /end AXIS_DESCR
/end CHARACTERISTIC
/begin MEASUREMENT myCar.myCar.myVehicle.h "" FLOAT32_IEEE esdl_ident 1 100.0 -3.4028234663852886E+38 3.4028234663852886E+38 ECU_ADDRESS 0x0 /end MEASUREMENT
/begin MEASUREMENT myCar.myCar.myVehicle.dh "" FLOAT32_IEEE esdl_ident 1 100.0 -3.4028234663852886E+38 3.4028234663852886E+38 ECU_ADDRESS 0x0 /end MEASUREMENT
/begin MEASUREMENT myCar.myCar.myVehicle.ds "" FLOAT32_IEEE esdl_ident 1 100.0 -3.4028234663852886E+38 3.4028234663852886E+38 ECU_ADDRESS 0x0 /end MEASUREMENT
/begin MEASUREMENT myCar.myCar.myVehicle.momentum "" FLOAT32_IEEE esdl_ident 1 100.0 -3.4028234663852886E+38 3.4028234663852886E+38 ECU_ADDRESS 0x0 /end MEASUREMENT
/begin MEASUREMENT myCar.myCar.myVehicle.dist "" FLOAT32_IEEE esdl_ident 1 100.0 -3.4028234663852886E+38 3.4028234663852886E+38 ECU_ADDRESS 0x0 /end MEASUREMENT
/begin CHARACTERISTIC myCar.myCar.myVehicle.TrackSize "" VALUE 0x0 STANDARD_VALUE_R32 0.0 esdl_ident -3.4028234663852886E+38 3.4028234663852886E+38 /end CHARACTERISTIC
/begin MEASUREMENT myCar.myCar.myVehicle.v "" UWORD esdl_f0_01_kmh 1 100.0 0.0 200.0 ECU_ADDRESS 0x0 /end MEASUREMENT
/begin MEASUREMENT myCar.myCar.myVehicle.x "" FLOAT32_IEEE esdl_ident 1 100.0 -3.4028234663852886E+38 3.4028234663852886E+38 ECU_ADDRESS 0x0 /end MEASUREMENT
/begin MEASUREMENT myCar.myCar.myVehicle.y "" FLOAT32_IEEE esdl_ident 1 100.0 -3.4028234663852886E+38 3.4028234663852886E+38 ECU_ADDRESS 0x0 /end MEASUREMENT
/begin MEASUREMENT myCar.myCar.myVehicle.bearing "" FLOAT32_IEEE esdl_ident 1 100.0 -3.4028234663852886E+38 3.4028234663852886E+38 ECU_ADDRESS 0x0 /end MEASUREMENT
/begin MEASUREMENT myCar.myCar.v "" FLOAT32_IEEE esdl_ident 1 100.0 -3.4028234663852886E+38 3.4028234663852886E+38 ECU_ADDRESS 0x0 /end MEASUREMENT
/begin MEASUREMENT myCar.myCar.time "" FLOAT32_IEEE esdl_ident 1 100.0 -3.4028234663852886E+38 3.4028234663852886E+38 ECU_ADDRESS 0x0 /end MEASUREMENT
/begin CHARACTERISTIC myCar.myCar.g "" VALUE 0x0 STANDARD_VALUE_R32 0.0 esdl_ident -3.4028234663852886E+38 3.4028234663852886E+38 /end CHARACTERISTIC
/begin CHARACTERISTIC myCar.myCar.delta "" VALUE 0x0 STANDARD_VALUE_R32 0.0 esdl_ident -3.4028234663852886E+38 3.4028234663852886E+38 /end CHARACTERISTIC
/begin MEASUREMENT resources.CarMessages.v "" UWORD esdl_f0_01_kmh_km2fh 1 100.0 0.0 200.0 ECU_ADDRESS 0x0 /end MEASUREMENT
/begin MEASUREMENT resources.CarMessages.power "" FLOAT32_IEEE esdl_ident 1 100.0 -3.4028234663852886E+38 3.4028234663852886E+38 ECU_ADDRESS 0x0 /end MEASUREMENT
/begin MEASUREMENT resources.CarMessages.brake "" FLOAT32_IEEE esdl_ident 1 100.0 -3.4028234663852886E+38 3.4028234663852886E+38 ECU_ADDRESS 0x0 /end MEASUREMENT
/begin MEASUREMENT resources.CarMessages.driverPower "" FLOAT32_IEEE esdl_ident 1 100.0 -3.4028234663852886E+38 3.4028234663852886E+38 ECU_ADDRESS 0x0 /end MEASUREMENT
/begin MEASUREMENT resources.CarMessages.driverBrake "" FLOAT32_IEEE esdl_ident 1 100.0 -3.4028234663852886E+38 3.4028234663852886E+38 ECU_ADDRESS 0x0 /end MEASUREMENT
/begin MEASUREMENT resources.CarMessages.steering "" FLOAT32_IEEE esdl_ident 1 100.0 -3.4028234663852886E+38 3.4028234663852886E+38 ECU_ADDRESS 0x0 /end MEASUREMENT
/begin MEASUREMENT resources.CarMessages.bearing "" FLOAT32_IEEE esdl_ident 1 100.0 -3.4028234663852886E+38 3.4028234663852886E+38 ECU_ADDRESS 0x0 /end MEASUREMENT
/begin MEASUREMENT resources.CarMessages.x "" FLOAT32_IEEE esdl_ident_m 1 100.0 -3.4028234663852886E+38 3.4028234663852886E+38 ECU_ADDRESS 0x0 /end MEASUREMENT
/begin MEASUREMENT resources.CarMessages.y "" FLOAT32_IEEE esdl_ident_m 1 100.0 -3.4028234663852886E+38 3.4028234663852886E+38 ECU_ADDRESS 0x0 /end MEASUREMENT
/begin COMPU_METHOD esdl_f0_01_kmh "" RAT_FUNC "%12.4" "" COEFFS 0 100 0 0 0 1 /end COMPU_METHOD
/begin COMPU_METHOD esdl_f0_01_kmh_km2fh "" RAT_FUNC "%12.4" "km/h" COEFFS 0 100 0 0 0 1 /end COMPU_METHOD
/begin COMPU_METHOD esdl_ident "" RAT_FUNC "%12.4" "" COEFFS 0 1 0 0 0 1 /end COMPU_METHOD
/begin COMPU_METHOD esdl_ident_m "" RAT_FUNC "%12.4" "m" COEFFS 0 1 0 0 0 1 /end COMPU_METHOD
/begin FUNCTION myCar.myCar "" /begin DEF_CHARACTERISTIC myCar.myCar.g myCar.myCar.delta /end DEF_CHARACTERISTIC
 /begin IN_MEASUREMENT resources.CarMessages.driverBrake resources.CarMessages.driverPower resources.CarMessages.steering /end IN_MEASUREMENT
 /begin OUT_MEASUREMENT resources.CarMessages.bearing resources.CarMessages.brake resources.CarMessages.power resources.CarMessages.v resources.CarMessages.x resources.CarMessages.y /end OUT_MEASUREMENT
 /begin LOC_MEASUREMENT myCar.myCar.time myCar.myCar.v /end LOC_MEASUREMENT
 /begin SUB_FUNCTION myCar.myCar.myVehicle /end SUB_FUNCTION
/end FUNCTION
/begin FUNCTION myCar.myCar.myVehicle ""
 /begin DEF_CHARACTERISTIC myCar.myCar.myVehicle.BrakeMomentum myCar.myCar.myVehicle.EngineMomentum myCar.myCar.myVehicle.AirFriction myCar.myCar.myVehicle.Landscape myCar.myCar.myVehicle.TrackSize /end DEF_CHARACTERISTIC
 /begin LOC_MEASUREMENT myCar.myCar.myVehicle.bearing myCar.myCar.myVehicle.dh myCar.myCar.myVehicle.dist myCar.myCar.myVehicle.ds myCar.myCar.myVehicle.h myCar.myCar.myVehicle.momentum myCar.myCar.myVehicle.v myCar.myCar.myVehicle.x myCar.myCar.myVehicle.y /end LOC_MEASUREMENT
 /begin SUB_FUNCTION myCar.myCar.myVehicle.MyTurn_instance /end SUB_FUNCTION
/end FUNCTION
/begin FUNCTION myCar.myCar.myVehicle.MyTurn_instance "" /begin DEF_CHARACTERISTIC myCar.myCar.myVehicle.MyTurn_instance.D /end DEF_CHARACTERISTIC
 /begin LOC_MEASUREMENT myCar.myCar.myVehicle.MyTurn_instance.bearing myCar.myCar.myVehicle.MyTurn_instance.dpi myCar.myCar.myVehicle.MyTurn_instance.pi myCar.myCar.myVehicle.MyTurn_instance.x myCar.myCar.myVehicle.MyTurn_instance.y /end LOC_MEASUREMENT
 /begin SUB_FUNCTION myCar.myCar.myVehicle.MyTurn_instance.Lib /end SUB_FUNCTION
/end FUNCTION
/begin FUNCTION myCar.myCar.myVehicle.MyTurn_instance.Lib "MathLib is a C code class that returns the results of numerous mathematical functions." /end FUNCTION
/begin FUNCTION myCar.TimeBase "" /end FUNCTION
/begin FUNCTION driver.driver ""
 /begin OUT_MEASUREMENT resources.CarMessages.driverBrake resources.CarMessages.driverPower /end OUT_MEASUREMENT
/end FUNCTION
/begin RECORD_LAYOUT STANDARD_CURVE_R32R32 /* axis size */ NO_AXIS_PTS_X 1 UWORD /* axis */ AXIS_PTS_X 2 FLOAT32_IEEE INDEX_INCR DIRECT FNC_VALUES 3 FLOAT32_IEEE COLUMN_DIR DIRECT /end RECORD_LAYOUT
/begin RECORD_LAYOUT STANDARD_MAP_R32R32R32 /* x axis size */ NO_AXIS_PTS_X 1 UWORD /* y axis size */ NO_AXIS_PTS_Y 2 UWORD /* x axis */ AXIS_PTS_X 3 FLOAT32_IEEE INDEX_INCR DIRECT /* y axis */ AXIS_PTS_Y 4 FLOAT32_IEEE INDEX_INCR DIRECT FNC_VALUES 5 FLOAT32_IEEE COLUMN_DIR DIRECT /end RECORD_LAYOUT
/begin RECORD_LAYOUT STANDARD_VALUE_R32 FNC_VALUES 1 FLOAT32_IEEE COLUMN_DIR DIRECT /end RECORD_LAYOUT
/begin GROUP driver.driver "" ROOT /end GROUP
/begin GROUP myCar.TimeBase "" ROOT /end GROUP
/begin GROUP myCar.myCar "" ROOT /begin REF_CHARACTERISTIC myCar.myCar.g myCar.myCar.delta /end REF_CHARACTERISTIC /begin REF_MEASUREMENT myCar.myCar.time myCar.myCar.v /end REF_MEASUREMENT /begin SUB_GROUP myCar.myCar.myVehicle /end SUB_GROUP /end GROUP
/begin GROUP myCar.myCar.myVehicle ""
 /begin REF_CHARACTERISTIC myCar.myCar.myVehicle.BrakeMomentum myCar.myCar.myVehicle.EngineMomentum myCar.myCar.myVehicle.AirFriction myCar.myCar.myVehicle.Landscape myCar.myCar.myVehicle.TrackSize /end REF_CHARACTERISTIC
 /begin REF_MEASUREMENT myCar.myCar.myVehicle.bearing myCar.myCar.myVehicle.dh myCar.myCar.myVehicle.dist myCar.myCar.myVehicle.ds myCar.myCar.myVehicle.h myCar.myCar.myVehicle.momentum myCar.myCar.myVehicle.v myCar.myCar.myVehicle.x myCar.myCar.myVehicle.y /end REF_MEASUREMENT
 /begin SUB_GROUP myCar.myCar.myVehicle.MyTurn_instance /end SUB_GROUP
/end GROUP
/begin GROUP myCar.myCar.myVehicle.MyTurn_instance "" /begin REF_CHARACTERISTIC myCar.myCar.myVehicle.MyTurn_instance.D /end REF_CHARACTERISTIC
 /begin REF_MEASUREMENT myCar.myCar.myVehicle.MyTurn_instance.bearing myCar.myCar.myVehicle.MyTurn_instance.dpi myCar.myCar.myVehicle.MyTurn_instance.pi myCar.myCar.myVehicle.MyTurn_instance.x myCar.myCar.myVehicle.MyTurn_instance.y /end REF_MEASUREMENT
 /begin SUB_GROUP myCar.myCar.myVehicle.MyTurn_instance.Lib /end SUB_GROUP
/end GROUP
/begin GROUP myCar.myCar.myVehicle.MyTurn_instance.Lib "MathLib is a C code class that returns the results of numerous mathematical functions." /end GROUP
/begin GROUP resources.CarMessages "" ROOT
 /begin REF_MEASUREMENT resources.CarMessages.bearing resources.CarMessages.brake resources.CarMessages.driverBrake resources.CarMessages.driverPower resources.CarMessages.power resources.CarMessages.steering resources.CarMessages.v resources.CarMessages.x resources.CarMessages.y /end REF_MEASUREMENT
/end GROUP
/end MODULE
/end PROJECT
